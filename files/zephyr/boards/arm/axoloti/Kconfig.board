## files/zephyr/boards/arm/axoloti/Kconfig.board
```kconfig
#  Copyright (c) 2021 Jason T. Harris
#  SPDX-License-Identifier: Apache-2.0

config BOARD_AXOLOTI
	bool "Axoloti Core (STM32F427)"
	depends on SOC_STM32F427XX
```

## files/zephyr/boards/arm/axoloti/Kconfig.defconfig
```kconfig
#  Copyright (c) 2021 Jason T. Harris
#  SPDX-License-Identifier: Apache-2.0

if BOARD_AXOLOTI

config BOARD
	default "axoloti"

endif # BOARD_AXOLOTI
```

## files/zephyr/drivers/audio/Kconfig.cs43l22
```kconfig
# Copyright (c) 2021 Jason T. Harris
# SPDX-License-Identifier: Apache-2.0

config AUDIO_CS43L22
	bool "CS43L22 DAC support"
	depends on I2C && GPIO
	help
	  Enable CS43L22 DAC support on the selected board
```

## files/zephyr/dts/bindings/audio/cirrus,cs43l22.yaml
```yaml
# Copyright (c) 2021, Jason T. Harris
# SPDX-License-Identifier: Apache-2.0

description: Cirrus Logic CS43L22 Audio DAC

compatible: "cirrus,cs43l22"

include: i2c-device.yaml

properties:
    reset-gpios:
      type: phandle-array
      required: true
```
